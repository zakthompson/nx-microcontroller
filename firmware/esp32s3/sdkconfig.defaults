## firmware/esp32s3/sdkconfig.defaults
```kconfig
# ESP32-S3 Configuration Defaults

# Target chip
CONFIG_IDF_TARGET="esp32s3"

# Enable native USB
CONFIG_TINYUSB_ENABLED=y
CONFIG_TINYUSB_HID_ENABLED=y

# USB configuration
CONFIG_TINYUSB_HID_COUNT=1

# Disable unnecessary features to save space
CONFIG_BOOTLOADER_LOG_LEVEL_NONE=y
CONFIG_LOG_DEFAULT_LEVEL_NONE=y

# Optimization
CONFIG_COMPILER_OPTIMIZATION_SIZE=y

# USB Device descriptor
CONFIG_TINYUSB_DESC_USE_ESPRESSIF_VID=n
CONFIG_TINYUSB_DESC_CUSTOM_VID=0x0F0D
CONFIG_TINYUSB_DESC_CUSTOM_PID=0x0092
```
